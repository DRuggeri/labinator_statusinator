#include <Arduino.h>
#include <Arduino_GFX_Library.h>
#include <ArduinoJson.h>
#include <stubby.hpp>

#define GFX_BL 1
Arduino_DataBus *bus = new Arduino_ESP32QSPI(
    45 /* cs */, 47 /* sck */, 21 /* d0 */, 48 /* d1 */, 40 /* d2 */, 39 /* d3 */);
Arduino_GFX *g = new Arduino_NV3041A(bus, GFX_NOT_DEFINED /* RST */, 0 /* rotation */, true /* IPS */);
Arduino_GFX *gfx = new Arduino_Canvas(480 /* width */, 272 /* height */, g);
#define CANVAS

// Drawing stub for Adafruit_GFX -> Arduino_GFX compatibility
stubby tft = stubby(gfx);


// Reading data from serial
const int numChars = 2048;
const int numLogs = 12;
char receivedChars[numChars];
boolean newData = false;

// Parsed data
JsonDocument doc;
JsonDocument tmp;
std::string logLines[numLogs] = {};

/* Example inputs:
status:{"initializer":{"LabName":"Narp","NumHypervisors":6,"InitializedHypervisors":5,"NumNodes":24,"InitializedNodes":20,"NumPods":56,"InitializedPods":50,"CurrentStep":"chillin"},"talos":null,"power":{"P1":false,"P2":false,"P3":false,"P4":false,"P5":false,"P6":false,"P7":true,"P8":false},"ports":{},"logs":{"NumMessages":1890537,"NumEmergencyMessages":5,"NumAlertMessages":0,"NumCriticalMessages":0,"NumErrorMessages":20,"NumWarnMessages":993038,"NumNoticeMessages":200,"NumInfoMessages":897279,"NumDebugMessages":0,"NumDHCPDiscover":15,"NumDHCPLeased":20,"NumDNSQueries":64125,"NumDNSLocal":130212,"NumDNSRecursions":3210,"NumDNSCached":29720,"NumCertChecks":10228,"NumCertOK":10369,"NumCertSigned":0,"NumCertRenewed":56,"NumFirewallWanInDrops":989423,"NumFirewallWanOutDrops":0,"NumFirewallWanDrops":989423,"NumFirewallLanInDrops":1122,"NumFirewallLanOutDrops":0,"NumFirewallLanDrops":1122,"IPXETalosChainload":0}}
log:{"Node":"wally","Service":"kernel","Level":"warning","Message":"[1812191.083652] drop wan in: IN=eth0 OUT= MAC=ff:ff:ff:ff:ff:ff:00:09:b0:e7:d4:5b:08:00 SRC=192.168.0.139 DST=192.168.0.255 LEN=1044 TOS=0x18 PREC=0xA0 TTL=64 ID=29118 DF PROTO=UDP SPT=10102 DPT=10102 LEN=1024","Attributes":{"MESSAGE":"[1812191.083652] drop wan in: IN=eth0 OUT= MAC=ff:ff:ff:ff:ff:ff:00:09:b0:e7:d4:5b:08:00 SRC=192.168.0.139 DST=192.168.0.255 LEN=1044 TOS=0x18 PREC=0xA0 TTL=64 ID=29118 DF PROTO=UDP SPT=10102 DPT=10102 LEN=1024","PRIORITY":"4","SYSLOG_IDENTIFIER":"kernel","detected_level":"warn","host_name":"wally","observed_timestamp":"1747963045167025992","service_name":"kernel","severity_number":"13","severity_text":"warning"}}
log:{"Node":"boss","Service":"dnsmasq.service","Level":"info","Message":"dnsmasq: cached virtual-2-workers.local is NODATA-IPv6","Attributes":{"MESSAGE":"dnsmasq: cached virtual-2-workers.local is NODATA-IPv6","PRIORITY":"6","SYSLOG_IDENTIFIER":"dnsmasq","detected_level":"info","host_name":"boss","level":"info","observed_timestamp":"1747963079200840866","service_name":"dnsmasq.service","severity_number":"9","severity_text":"info"}}□~□{"Node":"boss","Service":"dnsmasq.service","Level":"info","Message":"dnsmasq: config virtual-2-workers.local is 192.168.122.36","Attributes":{"MESSAGE":"dnsmasq: config virtual-2-workers.local is 192.168.122.36","PRIORITY":"6","SYSLOG_IDENTIFIER":"dnsmasq","detected_level":"info","host_name":"boss","level":"info","observed_timestamp":"1747963079202751046","service_name":"dnsmasq.service","severity_number":"9","severity_text":"info"}}
*/

void recvWithEndMarker();
boolean processData();
void draw();
void updateScreen();

void setup()
{
  Serial.setRxBufferSize(numChars);
  Serial.begin(115200);

  for (int x = 5000; x > 0; x-=1000) {
    Serial.print("Startup delay: ");
    Serial.println(x);
    delay(1000);
  }
  
  Serial.println("Setting up");

  if (!gfx->begin()) {
    Serial.println("gfx->begin() failed!");
  }
  
  pinMode(GFX_BL, OUTPUT);
  digitalWrite(GFX_BL, HIGH);

  updateScreen();
}

void loop()
{
  recvWithEndMarker();
  if (processData()) updateScreen();
}

void updateScreen() {
  tft.clearDisplay();
  draw();
  tft.display();
}

void recvWithEndMarker() {
    static int ndx = 0;
    char endMarker = '\n';
    char rc;

    while (Serial.available() > 0 && newData == false) {
        rc = Serial.read();

        if (rc != endMarker) {
            if (rc == '\r') return;
            receivedChars[ndx] = rc;
            ndx++;
            if (ndx >= numChars) {
                ndx = numChars - 1;
            }
        }
        else {
            receivedChars[ndx] = '\0';
            ndx = 0;
            newData = true;
        }
    }
}

boolean processData() {
  boolean ret = false;

  if (newData == true) {
    std::string input = receivedChars;

    int idx = input.find(":");
    if (idx == std::string::npos) {
      newData = false;
      return false;
    }

    std::string inputType = input.substr(0, idx);
    std::string inputData = input.substr(idx+1);
    if (inputType == "status") {
      DeserializationError err = deserializeJson(tmp, inputData.c_str());

      switch (err.code()) {
          case DeserializationError::Ok:
              doc = tmp;
              ret = true;
              break;
          case DeserializationError::InvalidInput:
              Serial.print("Invalid input!");
              Serial.println(inputData.c_str());
              break;
          case DeserializationError::NoMemory:
              Serial.println("Not enough memory");
              break;
          default:
              Serial.println("Deserialization failed");
              Serial.println(inputData.c_str());
              break;
      }
    } else if (inputType == "log") {
      for (int i = numLogs - 2; i >= 0 ; i--) {
        logLines[i+1] = logLines[i];
      }
      logLines[0] = inputData;
      ret = true;
    }

    newData = false;
  }

  return ret;
}

/* BEGIN GENERATED CODE */

static const unsigned char PROGMEM image_carbon__bare_metal_server_bits[] = {0x00,0x00,0x00,0x1f,0xff,0xf8,0x1f,0xff,0xf8,0x1b,0x00,0x18,0x1b,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0x00,0x00};

static const unsigned char PROGMEM image_carbon__checkbox_bits[] = {0x00,0x00,0x00,0x00,0x00,0x00,0x00,0x00,0x00,0x1f,0xff,0xf8,0x1f,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0x00,0x00};

static const unsigned char PROGMEM image_carbon__cics_transaction_server_zos_bits[] = {0x00,0x00,0x00,0x00,0x00,0x00,0x01,0xff,0x00,0x07,0xff,0x00,0x0f,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0x00,0x00};

static const unsigned char PROGMEM image_carbon__warning_alt_bits[] = {0x00,0x00,0x00,0x00,0x00,0x00,0x00,0x18,0x00,0x00,0x3c,0x00,0x00,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0x00,0x00};

static const unsigned char PROGMEM image_carbon__warning_diamond_bits[] = {0x00,0x00,0x00,0x00,0x3c,0x00,0x00,0x7e,0x00,0x00,0x7e,0x00,0x00,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0x00,0x00};

static const unsigned char PROGMEM image_carbon__warning_hex_bits[] = {0x00,0x00,0x00,0x00,0x00,0x00,0x07,0xff,0xe0,0x07,0xff,0xe0,0x0e,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0x00,0x00};

static const unsigned char PROGMEM image_material_symbols_light__block_bits[] = {0x00,0x00,0x00,0x00,0x00,0x00,0x00,0x00,0x00,0x00,0xff,0x00,0x03,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0x00,0x00};

static const unsigned char PROGMEM image_material_symbols_light__bug_report_outline_bits[] = {0x00,0x00,0x00,0x00,0x00,0x00,0x00,0x00,0x00,0x00,0x00,0x00,0x00,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0x00,0x00};

static const unsigned char PROGMEM image_material_symbols_light__chat_info_outline_bits[] = {0x00,0x00,0x00,0x00,0x00,0x00,0x00,0x00,0x00,0x1f,0xff,0xf8,0x18,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0x00,0x00};

static const unsigned char PROGMEM image_material_symbols_light__check_box_outline_rounded_bits[] = {0x00,0x00,0x00,0x00,0x00,0x00,0x00,0x00,0x00,0x00,0x00,0x00,0x0f,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0x00,0x00};

static const unsigned char PROGMEM image_material_symbols_light__check_circle_outline_bits[] = {0x00,0x00,0x00,0x00,0x00,0x00,0x00,0x00,0x00,0x00,0xff,0x00,0x03,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0x00,0x00};

static const unsigned char PROGMEM image_material_symbols_light__check_rounded_bits[] = {0x00,0x00,0x00,0x00,0x00,0x00,0x00,0x00,0x00,0x00,0x00,0x00,0x00,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0x00,0x00};

static const unsigned char PROGMEM image_material_symbols_light__e911_emergency_outline_bits[] = {0x00,0x00,0x00,0x00,0x00,0x00,0x00,0x00,0x00,0x00,0x00,0x00,0x00,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0x00,0x00};

static const unsigned char PROGMEM image_material_symbols_light__input_rounded_bits[] = {0x00,0x00,0x00,0x00,0x00,0x00,0x00,0x00,0x00,0x00,0x00,0x00,0x00,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0x00,0x00};

static const unsigned char PROGMEM image_material_symbols_light__output_bits[] = {0x00,0x00,0x00,0x00,0x00,0x00,0x00,0x00,0x00,0x00,0x00,0x00,0x0f,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0x00,0x00};

static const unsigned char PROGMEM image_material_symbols_light__question_mark_bits[] = {0x00,0x00,0x00,0x00,0x00,0x00,0x00,0x00,0x00,0x00,0x3c,0x00,0x00,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0x00,0x00};

static const unsigned char PROGMEM image_material_symbols_light__search_check_2_outline_bits[] = {0x00,0x00,0x00,0x00,0x00,0x00,0x00,0x00,0x00,0x03,0xfc,0x00,0x07,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0x00,0x00};

static const unsigned char PROGMEM image_material_symbols_light__settop_component_outline_bits[] = {0x00,0x00,0x00,0x00,0x00,0x00,0x00,0x00,0x00,0x00,0x00,0x00,0x00,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0x00,0x00};

static const unsigned char PROGMEM image_P1_bits[] = {0x00,0x00,0x00,0x00,0x00,0x00,0x00,0x00,0x00,0x00,0x00,0x00,0x00,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0x00,0x00};

void draw(void) {

    tft.setTextColor(0xFFFF);
    tft.setTextSize(2);
    tft.setTextWrap(false);
    tft.setCursor(2, 2);
    tft.print("Power");

    tft.drawBitmap(64, -3, image_P1_bits, 24, 24, doc["power"]["P1"] ? 0x400 : 0xB000);

    tft.drawBitmap(84, -3, image_P1_bits, 24, 24, doc["power"]["P2"] ? 0x400 : 0xB000);

    tft.drawBitmap(104, -3, image_P1_bits, 24, 24, doc["power"]["P3"] ? 0x400 : 0xB000);

    tft.drawBitmap(124, -3, image_P1_bits, 24, 24, doc["power"]["P4"] ? 0x400 : 0xB000);

    tft.drawBitmap(144, -3, image_P1_bits, 24, 24, doc["power"]["P5"] ? 0x400 : 0xB000);

    tft.drawBitmap(164, -3, image_P1_bits, 24, 24, doc["power"]["P6"] ? 0x400 : 0xB000);

    tft.drawBitmap(184, -3, image_P1_bits, 24, 24, doc["power"]["P7"] ? 0x400 : 0xB000);

    tft.drawBitmap(204, -3, image_P1_bits, 24, 24, doc["power"]["P8"] ? 0x400 : 0xB000);

    tft.setCursor(2, 25);
    tft.print("Logs");

    tft.drawBitmap(64, 21, image_carbon__warning_diamond_bits, 24, 24, 0xB000);

    tft.setTextSize(1);
    tft.setCursor(90, 30);
    tft.printInt(doc["logs"]["NumEmergencyMessages"]);

    tft.drawBitmap(133, 21, image_material_symbols_light__e911_emergency_outline_bits, 24, 24, 0xFC00);

    tft.setCursor(159, 30);
    tft.printInt(doc["logs"]["NumErrorMessages"]);

    tft.drawBitmap(203, 21, image_carbon__warning_hex_bits, 24, 24, 0xB580);

    tft.setCursor(231, 30);
    tft.printInt(doc["logs"]["NumWarnMessages"]);

    tft.drawBitmap(274, 21, image_carbon__warning_alt_bits, 24, 24, 0xC618);

    tft.setCursor(301, 30);
    tft.printInt(doc["logs"]["NumNoticeMessages"]);

    tft.drawBitmap(346, 23, image_material_symbols_light__chat_info_outline_bits, 24, 24, 0x39DF);

    tft.setCursor(371, 30);
    tft.printInt(doc["logs"]["NumInfoMessages"]);

    tft.drawBitmap(416, 20, image_material_symbols_light__bug_report_outline_bits, 24, 24, 0x400);

    tft.setCursor(439, 30);
    tft.printInt(doc["logs"]["NumDebugMessages"]);

    tft.setTextSize(2);
    tft.setCursor(2, 50);
    tft.print("DNS");

    tft.drawBitmap(65, 45, image_material_symbols_light__question_mark_bits, 24, 24, 0xC618);

    tft.setTextSize(1);
    tft.setCursor(87, 54);
    tft.printInt(doc["logs"]["NumDNSQueries"]);

    tft.drawBitmap(164, 45, image_material_symbols_light__check_circle_outline_bits, 24, 24, 0x408);

    tft.setCursor(191, 54);
    tft.printInt(doc["logs"]["NumDNSLocal"]);

    tft.drawBitmap(264, 45, image_material_symbols_light__check_box_outline_rounded_bits, 24, 24, 0x39DF);

    tft.setCursor(293, 54);
    tft.printInt(doc["logs"]["NumDNSCached"]);

    tft.drawBitmap(364, 45, image_material_symbols_light__search_check_2_outline_bits, 24, 24, 0xFC00);

    tft.setCursor(391, 54);
    tft.printInt(doc["logs"]["NumDNSRecursions"]);

    tft.setTextSize(2);
    tft.setCursor(2, 73);
    tft.print("WAN");

    tft.drawBitmap(44, 68, image_material_symbols_light__input_rounded_bits, 24, 24, 0xC618);

    tft.setTextSize(1);
    tft.setCursor(69, 77);
    tft.printInt(doc["logs"]["NumFirewallWanIn"]);

    tft.drawBitmap(136, 68, image_material_symbols_light__output_bits, 24, 24, 0xC618);

    tft.setCursor(161, 77);
    tft.printInt(doc["logs"]["NumFirewallWanOut"]);

    tft.drawBitmap(234, 68, image_material_symbols_light__block_bits, 24, 24, 0xB000);

    tft.setCursor(261, 76);
    tft.printInt(doc["logs"]["NumFirewallWanDrops"]);

    tft.setTextSize(2);
    tft.setCursor(2, 96);
    tft.print("LAN");

    tft.drawBitmap(44, 91, image_material_symbols_light__input_rounded_bits, 24, 24, 0xC618);

    tft.setTextSize(1);
    tft.setCursor(69, 100);
    tft.printInt(doc["logs"]["NumFirewallLanIn"]);

    tft.drawBitmap(136, 91, image_material_symbols_light__output_bits, 24, 24, 0xBDF7);

    tft.setCursor(161, 100);
    tft.printInt(doc["logs"]["NumFirewallLanOut"]);

    tft.drawBitmap(234, 91, image_material_symbols_light__block_bits, 24, 24, 0xB000);

    tft.setCursor(261, 99);
    tft.printInt(doc["logs"]["NumFirewallLanDrops"]);

    tft.setTextSize(2);
    tft.setCursor(385, 73);
    tft.print("DHCP");

    tft.drawBitmap(359, 91, image_material_symbols_light__question_mark_bits, 24, 24, 0x39DF);

    tft.setTextSize(1);
    tft.setCursor(382, 99);
    tft.printInt(doc["logs"]["NumDHCPDiscover"]);

    tft.drawBitmap(416, 91, image_material_symbols_light__check_rounded_bits, 24, 24, 0x400);

    tft.setCursor(442, 100);
    tft.printInt(doc["logs"]["NumDHCPLeased"]);

    tft.setTextSize(2);
    tft.setCursor(2, 119);
    tft.print("LAB");

    tft.setTextSize(1);
    tft.setCursor(47, 123);
    tft.print(doc["initializer"]["LabName"]);

    tft.drawBitmap(135, 114, image_carbon__bare_metal_server_bits, 24, 24, 0x4208);

    tft.setCursor(162, 116);
    tft.printInt(doc["initializer"]["InitializedHypervisors"]);

    tft.setCursor(162, 128);
    tft.printInt(doc["initializer"]["NumHypervisors"]);

    tft.drawBitmap(200, 115, image_material_symbols_light__settop_component_outline_bits, 24, 24, 0x408);

    tft.setCursor(228, 117);
    tft.printInt(doc["initializer"]["InitializedNodes"]);

    tft.setCursor(228, 127);
    tft.printInt(doc["initializer"]["NumNodes"]);

    tft.drawBitmap(265, 114, image_carbon__checkbox_bits, 24, 24, 0x8418);

    tft.setCursor(292, 117);
    tft.printInt(doc["initializer"]["InitializedPods"]);

    tft.setCursor(292, 127);
    tft.printInt(doc["initializer"]["NumPods"]);

    tft.drawBitmap(340, 114, image_carbon__cics_transaction_server_zos_bits, 24, 24, 0x418);

    tft.setCursor(370, 123);
    tft.print(doc["initializer"]["CurrentStep"]);

    tft.drawLine(479, 145, 0, 145, 0x4208);

    tft.setTextColor(0xBDF7);
    tft.setCursor(2, 149);
    tft.print(logLines[0].c_str());

    tft.setCursor(2, 159);
    tft.print(logLines[1].c_str());

    tft.setCursor(2, 169);
    tft.print(logLines[2].c_str());

    tft.setCursor(2, 179);
    tft.print(logLines[3].c_str());

    tft.setCursor(2, 189);
    tft.print(logLines[4].c_str());

    tft.setCursor(2, 199);
    tft.print(logLines[5].c_str());

    tft.setCursor(2, 209);
    tft.print(logLines[6].c_str());

    tft.setCursor(2, 219);
    tft.print(logLines[7].c_str());

    tft.setCursor(2, 229);
    tft.print(logLines[8].c_str());

    tft.setCursor(2, 239);
    tft.print(logLines[9].c_str());

    tft.setCursor(2, 249);
    tft.print(logLines[10].c_str());

    tft.setCursor(2, 259);
    tft.print(logLines[11].c_str());

}

/* END GENERATED CODE */